## br2-dsl2542b/package/swmirror/Config.in
```kconfig
config BR2_PACKAGE_SWMIRROR
	bool "swmirror"
	depends on BR2_LINUX_KERNEL
	help
	  Port mirroring configuration for the BCM5325E switch via its
	  pseudo-PHY (MDIO, SIOCGMIIREG/SIOCSMIIREG ioctl on eth0).

	  Installs /usr/sbin/swmirror and the init script
	  /etc/init.d/S41swmirror, which enables mirroring at boot
	  according to /etc/swmirror.conf.
```
